GPIO_PORTA_DATA			EQU	0x400043FC	; Port A Data
SSI0_DR					EQU	0x40008008
SSI0_SR					EQU	0x4000800C


;LABEL			DIRECTIVE	VALUE				COMMENT	
				AREA screen,	CODE,	READONLY,	ALIGN=2
				THUMB
					
				EXPORT		SCR_XY
				EXPORT		SCR_CHAR
				EXPORT		SCR_BYTE
				EXPORT		labels_lcd
				EXPORT		num_lcd
					
ASCII	DCB		0x00, 0x00, 0x00, 0x00, 0x00 ;// 20
		DCB		0x00, 0x00, 0x5f, 0x00, 0x00 ;// 21 !
		DCB		0x00, 0x07, 0x00, 0x07, 0x00 ;// 22 "
		DCB		0x14, 0x7f, 0x14, 0x7f, 0x14 ;// 23 #
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  		DCB		0x10, 0x08, 0x08, 0x10, 0x08 ;// 7e ~					
					
				;WRITE PERMANENT LABELS TO THE SCREEN
				;freq label
labels_lcd		PUSH    {R4,R6,LR}
				MOV		R0,#0X0
				MOV		R1,#0X0
				BL		SCR_XY			;SET CURSOR TO THE BEGINNING				
		
				
				MOV		R5,#0X46		;f
				BL		SCR_CHAR
				MOV		R5,#0X52		;r
				BL		SCR_CHAR
				MOV		R5,#0X45		;e
				BL		SCR_CHAR				
				MOV		R5,#0X51		;q
				BL		SCR_CHAR				
				MOV		R5,#0X3A		;:
				BL		SCR_CHAR
				MOV		R5,#0X20		;SPACE
				BL		SCR_CHAR   
				
				;amplitude label
				MOV		R0,#0X0
				MOV		R1,#0X1
				BL		SCR_XY			;SET CURSOR TO THE BEGINNING				
		
				
				MOV		R5,#0X41		;a
				BL		SCR_CHAR
				MOV		R5,#0X4d		;m
				BL		SCR_CHAR
				MOV		R5,#0X50		;p
				BL		SCR_CHAR
				MOV		R5,#0X3A		;:
				BL		SCR_CHAR
				MOV		R5,#0X20		;SPACE
				BL		SCR_CHAR   
				
				;THRESHOLD label
				MOV		R0,#0X0
				MOV		R1,#0X2
				BL		SCR_XY			;SET CURSOR TO THE BEGINNING				
		
				
				MOV		R5,#0X54		;T
				BL		SCR_CHAR
				MOV		R5,#0X52		;R
				BL		SCR_CHAR
				MOV		R5,#0X53		;S
				BL		SCR_CHAR
				MOV		R5,#0X48		;H
				BL		SCR_CHAR
				MOV		R5,#0X46		;F
				BL		SCR_CHAR
				MOV		R5,#0X3A		;:
				BL		SCR_CHAR
				MOV		R5,#0X20		;SPACE
				BL		SCR_CHAR
				
				MOV		R0,#35
				MOV		R1,#0X2
				BL		SCR_XY			;SET CURSOR TO THE BEGINNING				
		
				
				MOV		R5,#0X33		;3
				BL		SCR_CHAR
				MOV		R5,#0X30		;0
				BL		SCR_CHAR
				MOV		R5,#0X30		;0
				BL		SCR_CHAR
				MOV		R5,#0X20		;SPACE
				BL		SCR_CHAR
				MOV		R5,#0X35		;3
				BL		SCR_CHAR
				MOV		R5,#0X30		;0
				BL		SCR_CHAR
				MOV		R5,#0X30		;0
				BL		SCR_CHAR
				
				MOV		R0,#0X0
				MOV		R1,#0X3
				BL		SCR_XY			;SET CURSOR TO THE BEGINNING				
		
				
				MOV		R5,#0X54		;T
				BL		SCR_CHAR
				MOV		R5,#0X52		;R
				BL		SCR_CHAR
				MOV		R5,#0X53		;S
				BL		SCR_CHAR
				MOV		R5,#0X48		;H
				BL		SCR_CHAR
				MOV		R5,#0X41		;a
				BL		SCR_CHAR
				MOV		R5,#0X3A		;:
				BL		SCR_CHAR
				MOV		R5,#0X20		;SPACE
				BL		SCR_CHAR
				
				MOV		R0,#35
				MOV		R1,#0X3
				BL		SCR_XY			;SET CURSOR TO THE BEGINNING				
		
				MOV		R5,#0X31		;3
				BL		SCR_CHAR
				MOV		R5,#0X30		;0
				BL		SCR_CHAR
			
				  
				
				POP		{R4,R6,LR}
				BX 		LR
				
num_lcd			
				PUSH {R0-R3}
				PUSH {R8-R12}
				MOV	R0,R5
				
				MOV R8,#100 ;will be used for calculations
				
				;lets assume  R0 val is= 241(for  better ;understanding)
				UDIV R10,R0,R8 ;241/100 =2 will be stored in ;R10, FIRST DIGIT
				ADD R5,R10,#0X30 ; to print first digit, add ;0x30 for ASCII conversion
				PUSH  {LR}
				BL	SCR_CHAR ; print the ascii char for first ;digit.
				POP  {LR}
				
				
				MUL R3,R10,R8 ; multiply first digit with ;100, 2*100=200 IN R3
				SUB R2,R0,R3 ;241-200 =41 stored in R2, this ;step for second digit
				
				MOV R9,#10; will be used for division
				UDIV R11,R2,R9; 41/10 =4 in R11 , SECOND ;DIGIT FOUND
				ADD R5,R11,#0X30 ;CONVERT TO ASCII 
				PUSH  {LR}
				BL	SCR_CHAR
				POP  {LR}
				
				MUL R12,R11,R9;4X10 =40 R12 ,Find last digit ;by multiply r11 with 10
				SUB R2,R12 ;41-40 =1 R11 , take difference to ;find last digit
				ADD R12,R2,#0X30 ;add 0x30 for ascii ;conversion
				MOV R5,R12 
				PUSH  {LR}
				BL	SCR_CHAR
				POP  {LR}
				
				POP {R0-R3}
				POP {R8-R12}
				BX LR
				
					;SEND ONE BYTE ON R5
SCR_BYTE			PUSH	{R0,R1}
BYTELOOP			LDR		R1,=SSI0_SR				; CHECK UNTIL NOT FULL
					LDR		R0,[R1]
					ANDS	R0,R0,#0x02
					BEQ		BYTELOOP
					LDR		R1,=SSI0_DR
					STRB	R5,[R1]
					POP		{R0,R1}
					BX		LR	


					; DISPLAY ASCII CHARACTER ON R5
SCR_CHAR			PUSH	{R0-R4,LR}
					LDR		R1,=GPIO_PORTA_DATA		; DATA MODE
					LDR		R0,[R1]
					ORR		R0,#0x40
					STR		R0,[R1]
					LDR		R1,=ASCII
					SUB		R2,R5,#0x20				; OFFSET
					MOV		R3,#0x05
					MUL		R2,R2,R3				; EACH CHAR IS 5 BYTE
					ADD		R1,R1,R2
					MOV		R0,#0x05				; EACH CHAR IS 5 BYTE
					
DISP_CHAR			LDRB	R5,[R1],#1				
					BL		SCR_BYTE				
					SUBS	R0,R0,#1
					BNE		DISP_CHAR
					
					MOV		R5,#0X00				; SPACE AFTER
					BL		SCR_BYTE				
					
CHAREND				LDR		R1,=SSI0_SR			
					LDR		R0,[R1]
					ANDS	R0,R0,#0x10				; CHECK BUSY
					BNE		CHAREND
					
					POP		{R0-R4,LR}
					BX		LR
					
					; SET THE CURSOR, X ON R0, Y ON R1
SCR_XY				PUSH	{R0-R5,LR}

					PUSH	{R0-R1}
					LDR		R1,=GPIO_PORTA_DATA		; COMMAND MODE
					LDR		R0,[R1]
					BIC		R0,#0x40
					STR		R0,[R1]
					MOV		R5,#0x20				; H=0
					BL		SCR_BYTE	
					POP		{R0-R1}
					
					MOV		R5,R1					; Y
					ORR		R5,#0x40
					BL		SCR_BYTE
					MOV		R5,R0					; X
					ORR		R5,#0x80
					BL		SCR_BYTE
					
XYEND				LDR		R1,=SSI0_SR				; wait until SSI is done
					LDR		R0,[R1]
					ANDS	R0,R0,#0x10
					BNE		XYEND
					
					LDR		R1,=GPIO_PORTA_DATA		; BACK TO DATA MODE
					LDR		R0,[R1]
					ORR		R0,#0x40
					STR		R0,[R1]
					POP		{R0-R5,LR}
					BX		LR
	
					
				
				
					

				ALIGN
				END
				
				